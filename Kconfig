## Kconfig
```kconfig
menu "esp-libsupla"

    config ESP_LIBSUPLA_USE_ESP_TLS
        bool "Use ESP-TLS for secure connection with cloud"
        default y
        help
            On ESP8266 with F_CPU 80MHz SSL handshake may be unstable, use F_CPU 160MHz

endmenu
```
